/*
 * Copyright (c) 2020 The ZMK Contributors
 *
 * SPDX-License-Identifier: MIT
 */

#include "microdox.dtsi"

&default_transform {
	col-offset = <5>;
};

&oled {
	segment-remap;
	com-invdir;
};

&kscan0 {
	col-gpios
		// = <&pro_micro_d 15 GPIO_ACTIVE_HIGH>
        // change pin D15 to D14 as output D15 (B1) is broken on the right side.
		= <&pro_micro_d 14 GPIO_ACTIVE_HIGH>
		, <&pro_micro_a  0 GPIO_ACTIVE_HIGH>
		, <&pro_micro_a  1 GPIO_ACTIVE_HIGH>
		, <&pro_micro_a  2 GPIO_ACTIVE_HIGH>
		, <&pro_micro_a  3 GPIO_ACTIVE_HIGH>
		;
};
